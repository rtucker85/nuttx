## arch/arm/src/am263x/Kconfig
```kconfig
############################################################################
# arch/arm/src/am263x/Kconfig
#
# SPDX-License-Identifier: Apache-2.0
#
# Licensed to the Apache Software Foundation (ASF) under one or more
# contributor license agreements.  See the NOTICE file distributed with
# this work for additional information regarding copyright ownership.  The
# ASF licenses this file to you under the Apache License, Version 2.0 (the
# "License"); you may not use this file except in compliance with the
# License.  You may obtain a copy of the License at
#
#   http://www.apache.org/licenses/LICENSE-2.0
#
# Unless required by applicable law or agreed to in writing, software
# distributed under the License is distributed on an "AS IS" BASIS, WITHOUT
# WARRANTIES OR CONDITIONS OF ANY KIND, either express or implied.  See the
# License for the specific language governing permissions and limitations
# under the License.
#
############################################################################
#
# For a description of the syntax of this configuration file,
# see the file kconfig-language.txt in the NuttX tools repository.
#

comment "AM263x Configuration Options"

choice
	prompt "AM263x chip"
	default ARCH_CHIP_AM2634

config ARCH_CHIP_AM2631
	bool "AM2631 (1x Cortex-R5F)"

config ARCH_CHIP_AM2632
	bool "AM2632 (2x Cortex-R5F)"

config ARCH_CHIP_AM2634
	bool "AM2634 (4x Cortex-R5F)"

endchoice # AM263x chip

menu "AM263x Peripheral Selection"

config AM263X_PRU
	bool "ICSSM PRU cores"
	default n
	---help---
		Character drivers for the two PRU cores of ICSSM0 (/dev/pru0,
		/dev/pru1): load firmware into a core's IRAM and DMEM, start and
		stop it, and read and write its DMEM.  See
		arch/arm/include/am263x/pru.h.

config AM263X_MCSPI
	bool
	default n

config AM263X_MCSPI0
	bool "MCSPI0"
	default n
	depends on SPI
	select AM263X_MCSPI

config AM263X_MCSPI1
	bool "MCSPI1"
	default n
	depends on SPI
	select AM263X_MCSPI

config AM263X_MCSPI2
	bool "MCSPI2"
	default n
	depends on SPI
	select AM263X_MCSPI

config AM263X_MCSPI3
	bool "MCSPI3"
	default n
	depends on SPI
	select AM263X_MCSPI

config AM263X_MCSPI4
	bool "MCSPI4"
	default n
	depends on SPI
	select AM263X_MCSPI

config AM263X_I2C
	bool
	default n
	select I2C
	select ARCH_HAVE_I2CRESET

config AM263X_I2C0
	bool "I2C0"
	default n
	select AM263X_I2C

config AM263X_I2C1
	bool "I2C1"
	default n
	select AM263X_I2C

config AM263X_I2C2
	bool "I2C2"
	default n
	select AM263X_I2C

config AM263X_I2C3
	bool "I2C3"
	default n
	select AM263X_I2C

config AM263X_CPSW
	bool
	default n

config AM263X_MDIO
	bool "CPSW MDIO controller"
	default n
	depends on NET
	select AM263X_CPSW
	select NETDEVICES
	select MDIO_BUS
	---help---
		The CPSW's MDIO controller as an MDIO bus lower half
		(am263x_mdio_initialize()), for managing the Ethernet PHYs.

config AM263X_CPSW_ETH
	bool "CPSW Ethernet"
	default n
	depends on NET
	select AM263X_MDIO
	select NET_PHYLIB
	select MM_IOB
	select ARCH_HAVE_NETDEV_STATISTICS
	---help---
		Ethernet through one MAC port of the CPSW3G, as eth0.  The
		switch is bypassed: the other MAC port is disabled.  The board
		registers the PHY driver (PHYLIB) and may supply the MAC address
		(am263x_cpsw_macaddr()).

endmenu # AM263x Peripheral Selection

menu "AM263x I2C Configuration"
	depends on AM263X_I2C

config AM263X_I2C_TIMEOUT_MS
	int "I2C transfer timeout slack (ms)"
	default 20
	---help---
		Added to four times the nominal duration of every transfer
		segment before it is abandoned and the module reset.  Also
		bounds how long a transfer waits for the bus to go idle.

config AM263X_I2C_LOOPBACK
	bool "I2C digital loopback (self-test)"
	default n
	---help---
		Provide am263x_i2c_loopback(): the module addresses itself
		(I2CMDR.DLB), so master-transmit transfers complete and the
		bytes come back through the receive register with nothing on
		the bus.  For a board self-test.

endmenu # AM263x I2C Configuration

menu "AM263x MDIO Configuration"
	depends on AM263X_MDIO

config AM263X_MDIO_FREQUENCY
	int "MDC frequency (Hz)"
	default 2200000
	---help---
		The MDIO bus clock, divided down from the 200 MHz CPSW clock.
		IEEE 802.3 allows up to 2.5 MHz; many PHYs, the DP83869
		among them, accept more.

endmenu # AM263x MDIO Configuration

menu "AM263x CPSW Ethernet Configuration"
	depends on AM263X_CPSW_ETH

config AM263X_CPSW_ETH_PORT
	int "MAC port"
	default 1
	range 1 2
	---help---
		The CPSW MAC port the interface uses.  On the LP-AM263 port 1
		(RGMII1) goes to J7.

config AM263X_CPSW_ETH_PHYADDR
	int "PHY MDIO address"
	default 3
	range 0 31

config AM263X_CPSW_ETH_RGMII_INTERNAL_DELAY
	bool "SoC adds the RGMII delays"
	default y
	---help---
		Leave the SoC's internal RGMII clock delays on (CPSW_CONTROL
		RGMIIn_ID_MODE = 0), as TI's SDK does for the LP-AM263.

choice
	prompt "RGMII delays the PHY adds"
	default AM263X_CPSW_ETH_PHY_RGMII_ID
	---help---
		The PHY interface mode PHYLIB passes to the PHY driver.  The
		LP-AM263, as TI's SDK sets it up, has the DP83869 shift both
		clocks (and CONFIG_NET_PHY_TI_DP83869_TX/RX_DELAY_PS = 500).

config AM263X_CPSW_ETH_PHY_RGMII
	bool "None (RGMII)"

config AM263X_CPSW_ETH_PHY_RGMII_ID
	bool "TX and RX (RGMII_ID)"

config AM263X_CPSW_ETH_PHY_RGMII_TXID
	bool "TX only (RGMII_TXID)"

config AM263X_CPSW_ETH_PHY_RGMII_RXID
	bool "RX only (RGMII_RXID)"

endchoice

config AM263X_CPSW_ETH_NRXDESC
	int "RX descriptors"
	default 32
	---help---
		Each has a 1536-byte buffer.

config AM263X_CPSW_ETH_NTXDESC
	int "TX descriptors"
	default 16
	---help---
		Each has a 1536-byte buffer.  Also the number of packets the
		driver may hold (its TX quota).

endmenu # AM263x CPSW Ethernet Configuration

menu "AM263x MCSPI Configuration"
	depends on AM263X_MCSPI

config AM263X_MCSPI_LOOPBACK
	bool "Loop D0 back to the receiver"
	default n
	---help---
		Receive on D0, the pin the controller transmits on, instead of
		D1, so every word sent comes back through the D0 pad.  For
		testing a bus without wiring or a device.  The D0 pad must have
		its input enabled.

endmenu # AM263x MCSPI Configuration
```

## drivers/motor/Kconfig
```kconfig
############################################################################
# drivers/motor/Kconfig
#
# SPDX-License-Identifier: Apache-2.0
#
# Licensed to the Apache Software Foundation (ASF) under one or more
# contributor license agreements.  See the NOTICE file distributed with
# this work for additional information regarding copyright ownership.  The
# ASF licenses this file to you under the Apache License, Version 2.0 (the
# "License"); you may not use this file except in compliance with the
# License.  You may obtain a copy of the License at
#
#   http://www.apache.org/licenses/LICENSE-2.0
#
# Unless required by applicable law or agreed to in writing, software
# distributed under the License is distributed on an "AS IS" BASIS, WITHOUT
# WARRANTIES OR CONDITIONS OF ANY KIND, either express or implied.  See the
# License for the specific language governing permissions and limitations
# under the License.
#
############################################################################
#
# For a description of the syntax of this configuration file,
# see the file kconfig-language.txt in the NuttX tools repository.
#

menuconfig MOTOR
	bool "Motor control drivers"
	default n

if MOTOR

config MOTOR_UPPER
	bool "Motor generic upper-half driver"
	default n
	---help---
		Enables building of a motor generic upper half driver.

if MOTOR_UPPER

config MOTOR_UPPER_HAVE_POSITION
	bool "Have position control"
	default n

config MOTOR_UPPER_HAVE_DIRECTION
	bool "Have direction control"
	default n

config MOTOR_UPPER_HAVE_SPEED
	bool "Have speed control"
	default n

config MOTOR_UPPER_HAVE_TORQUE
	bool "Have torque control (rotary motors)"
	default n

config MOTOR_UPPER_HAVE_FORCE
	bool "Have force control (linear motors)"
	default n

config MOTOR_UPPER_HAVE_ACCELERATION
	bool "Have acceleration control"
	default n

config MOTOR_UPPER_HAVE_DECELERATION
	bool "Have deceleration control"
	default n

config MOTOR_UPPER_HAVE_INPUT_VOLTAGE
	bool "Have input voltage protection"
	default n

config MOTOR_UPPER_HAVE_INPUT_CURRENT
	bool "Have input current protection"
	default n

config MOTOR_UPPER_HAVE_INPUT_POWER
	bool "Have input power protection"
	default n

endif

config MOTOR_DRV8145
	bool "TI DRV8145-Q1 half-bridge drivers (SPI daisy chain)"
	default n
	depends on SPI
	---help---
		A daisy chain of TI DRV8145-Q1 half-bridge drivers (or the
		DRV8143 and DRV8144, which share its register map) on one SPI
		chip select, as /dev/hbN: configuration, output control through
		SPI_IN and the board's IN and DRVOFF pins, status and fault
		clearing, off-state diagnostics, and set-up again after a
		power-on reset.

if MOTOR_DRV8145

config MOTOR_DRV8145_FREQUENCY
	int "SPI frequency (Hz)"
	default 5000000
	range 100000 10000000
	---help---
		SCLK for the chain; the device allows up to 10 MHz.

config MOTOR_DRV8145_OLP_SETTLE_US
	int "Off-state diagnostics settling time (us)"
	default 1000
	range 10 100000
	---help---
		How long the output is left to settle with each OLP pull-up or
		pull-down before the comparator is read.  The internal resistors
		are 1 kohm, so this depends mostly on the capacitance on the
		output.

menu "Default configuration"

comment "Used when the board gives no CONFIG1-4; changeable at run time"

config MOTOR_DRV8145_SR
	int "Slew rate (S_SR, 0-7)"
	default 0
	range 0 7
	---help---
		Output rise time, typical with high-side recirculation at 13.5 V:
		0 1.5, 1 4.7, 2 9.6, 3 14.4, 4 20.6, 5 26.5, 6 37.9, 7 47.1 V/us.
		Slower is quieter (EMI), faster switches with less loss.

config MOTOR_DRV8145_ITRIP
	int "ITRIP current regulation (S_ITRIP, 0-7)"
	default 0
	range 0 7
	---help---
		The IPROPI voltage at which the bridge regulates the current: 0
		off, 1 1.18, 2 1.41, 3 1.65, 4 1.98, 5 2.31, 6 2.64, 7 2.97 V.

config MOTOR_DRV8145_TOFF
	int "ITRIP off time (TOFF, 0-3)"
	default 1
	range 0 3
	---help---
		0 20, 1 30, 2 40, 3 50 us.

config MOTOR_DRV8145_OCP
	int "Overcurrent threshold (OCP_SEL, 0-2)"
	default 0
	range 0 2
	---help---
		0 100 %, 1 50 %, 2 75 % of the full threshold.

config MOTOR_DRV8145_TOCP
	int "Overcurrent filter (TOCP_SEL, 0-3)"
	default 0
	range 0 3
	---help---
		0 6, 1 3, 2 1.5 us, 3 the minimum (about 0.2 us).

config MOTOR_DRV8145_VMOV
	int "VM overvoltage threshold (VMOV_SEL, 0-3)"
	default 0
	range 0 3
	---help---
		0 35 V, 1 28 V, 2 18 V, 3 off.

config MOTOR_DRV8145_LOAD_VM
	bool "Load to VM (driven by the low side)"
	default n
	---help---
		S_DIAG load type.  A load to GND keeps IPROPI and ITRIP; a load
		to VM keeps active open load detection instead.

config MOTOR_DRV8145_OLP
	bool "Off-state diagnostics (OLP)"
	default n

config MOTOR_DRV8145_OLA
	bool "Open load detection while active (EN_OLA)"
	default n

config MOTOR_DRV8145_SSC
	bool "Spread spectrum clocking"
	default n

config MOTOR_DRV8145_OCP_RETRY
	bool "Retry after overcurrent (else latch)"
	default n

config MOTOR_DRV8145_TSD_RETRY
	bool "Retry after overtemperature (else latch)"
	default n

config MOTOR_DRV8145_VMOV_RETRY
	bool "Retry after VM over- or undervoltage (else latch)"
	default n

config MOTOR_DRV8145_OLA_RETRY
	bool "Retry after an active open load (else latch)"
	default n

endmenu # Default configuration

endif # MOTOR_DRV8145

source "drivers/motor/foc/Kconfig"

endif # MOTOR

menuconfig STEPPER
	bool "Stepper control drivers"
	default n

if STEPPER

config STEPPER_UPPER
	bool "Stepper Motor Generic upper-half driver"
	default n
	---help---
		Enables building of a stepper generic upper half driver.

config STEPPER_A4988
	bool "A4988 Stepper Motor Driver"
	default n
	---help---
		Enables A4988 stepper driver.

config STEPPER_DRV8825
	bool "DRV8825 Stepper Motor Driver"
	default n
	---help---
		Enables DRV8825 stepper driver.

endif # STEPPER
```
